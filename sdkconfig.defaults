## sdkconfig.defaults
```kconfig
# LVGL Configuration
CONFIG_LV_COLOR_DEPTH_16=y
CONFIG_LV_COLOR_16_SWAP=n

# LVGL Fonts
CONFIG_LV_FONT_MONTSERRAT_14=y
CONFIG_LV_FONT_MONTSERRAT_20=y
CONFIG_LV_FONT_MONTSERRAT_24=y

# FreeRTOS Configuration
CONFIG_FREERTOS_HZ=1000

# ESP32S3 Configuration
CONFIG_ESP_DEFAULT_CPU_FREQ_MHZ_240=y

# SPI Configuration
CONFIG_SPI_MASTER_ISR_IN_IRAM=y

# I2C Configuration
CONFIG_I2C_ENABLE_DEBUG_LOG=n

# LCD Touch FT5x06
CONFIG_ESP_LCD_TOUCH_MAX_BUTTONS=1

# Memory Configuration
CONFIG_ESP_MAIN_TASK_STACK_SIZE=8192
CONFIG_FREERTOS_TIMER_TASK_STACK_DEPTH=4096

# LVGL Task Configuration - Use ESP-IDF native tick
CONFIG_LV_TICK_CUSTOM=n
CONFIG_LV_MEM_CUSTOM=n
```
